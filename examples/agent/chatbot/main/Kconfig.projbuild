## examples/agent/chatbot/main/Kconfig.projbuild
```kconfig
menu "Chatbot Configuration"

    menuconfig EXAMPLE_AGENTS_ENABLE_CUSTOM_IA
        bool "Enable CustomIA agent"
        select BROOKESIA_AGENT_CUSTOM_IA_ENABLE_AUTO_REGISTER
        default n

    if EXAMPLE_AGENTS_ENABLE_CUSTOM_IA
        config EXAMPLE_AGENTS_CUSTOM_IA_SERVER_URL
            string "Backend server URL"
            default "http://192.168.1.100:3000"
            help
                Base URL of the CustomIA HTTP backend, as reachable from the device (LAN address of the
                machine running it). Must not have a trailing slash.
    endif

    menuconfig EXAMPLE_SD_UPDATE_ENABLE
        bool "Enable SD card update from web service"
        default n
        help
            On the first Wi-Fi connection, fetch the list of files to update from the SD update
            server ("{URL}/update", GET), compare them (by MD5) against what's already under
            /sdcard/update, and download any missing/changed file ("{URL}/update", POST) into that
            folder, creating sub-folders as needed.

    if EXAMPLE_SD_UPDATE_ENABLE
        config EXAMPLE_SD_UPDATE_SERVER_URL
            string "SD update server URL"
            default "http://192.168.1.100:4000"
            help
                Base URL of the SD update HTTP backend, as reachable from the device (LAN address of
                the machine running it). Must not have a trailing slash.
    endif

    menuconfig EXAMPLE_FW_UPDATE_ENABLE
        bool "Enable firmware OTA update from web service"
        default n
        help
            On the first Wi-Fi connection, fetch the current firmware version from the firmware
            update server ("{URL}/firmware", GET -> {"version": ..., "md5": ...}), compare it
            against the version recorded in /sdcard/VERSION (created with "0" if missing), and if
            the server's version is higher: download the firmware ("{URL}/firmware/{version}", GET)
            to the SD card verifying its MD5, copy it into the inactive ota_0/ota_1 partition
            verifying the MD5 again, switch the bootloader to that partition, and reboot.

    if EXAMPLE_FW_UPDATE_ENABLE
        config EXAMPLE_FW_UPDATE_SERVER_URL
            string "Firmware update server URL"
            default "http://192.168.1.100:4000"
            help
                Base URL of the firmware update HTTP backend, as reachable from the device (LAN
                address of the machine running it). Must not have a trailing slash.
    endif
endmenu
```

## hal/brookesia_hal_adaptor/test_apps/sdkconfig.defaults.esp32p4
```kconfig
CONFIG_SR_WN_WN9_HIESP=y

CONFIG_BT_ENABLED=y
CONFIG_BT_CONTROLLER_DISABLED=y
CONFIG_BT_BLUEDROID_ENABLED=n
CONFIG_BT_NIMBLE_ENABLED=y
CONFIG_BT_NIMBLE_ROLE_PERIPHERAL=y
CONFIG_BT_NIMBLE_GATT_SERVER=y
CONFIG_BT_NIMBLE_MAX_CONNECTIONS=1
CONFIG_BT_NIMBLE_TRANSPORT_UART=n
CONFIG_ESP_WIFI_REMOTE_LIBRARY_HOSTED=y
CONFIG_ESP_HOSTED_CP_TARGET_ESP32C6=y
CONFIG_ESP_HOSTED_P4_DEV_BOARD_FUNC_BOARD=y
CONFIG_ESP_HOSTED_SDIO_HOST_INTERFACE=y
CONFIG_ESP_HOSTED_ENABLE_BT_NIMBLE=y
CONFIG_ESP_HOSTED_NIMBLE_HCI_VHCI=y
CONFIG_BROOKESIA_HAL_ADAPTOR_ENABLE_BLE_DEVICE=y
```

## hal/brookesia_hal_adaptor/test_apps/sdkconfig.defaults.esp32s3
```kconfig
CONFIG_SR_WN_WN9_HIESP=y

CONFIG_BT_ENABLED=y
CONFIG_BT_BLUEDROID_ENABLED=n
CONFIG_BT_NIMBLE_ENABLED=y
CONFIG_BT_NIMBLE_ROLE_PERIPHERAL=y
CONFIG_BT_NIMBLE_GATT_SERVER=y
CONFIG_BT_NIMBLE_MAX_CONNECTIONS=1
CONFIG_BROOKESIA_HAL_ADAPTOR_ENABLE_BLE_DEVICE=y
```

## service/agent/brookesia_agent_custom_ia/Kconfig
```kconfig
menu "ESP-Brookesia: Agent CustomIA Configurations"
    config BROOKESIA_AGENT_CUSTOM_IA_ENABLE_AUTO_REGISTER
        bool "Enable automatic plugin registration"
        default y
        help
            Automatically register the agent as a plugin on startup.

    config BROOKESIA_AGENT_CUSTOM_IA_ENABLE_DEBUG_LOG
        bool "Enable debug or lower level logs"
        default n

    config BROOKESIA_AGENT_CUSTOM_IA_STT_SAMPLE_RATE
        int "Uplink (recording) sample rate in Hz"
        default 16000
        help
            Sample rate used to record and upload audio to the backend's STT endpoint.

    config BROOKESIA_AGENT_CUSTOM_IA_TTS_SAMPLE_RATE
        int "Downlink (playback) sample rate in Hz"
        default 24000
        help
            Sample rate assumed for the WAV audio returned by the backend's TTS endpoint.
            This must match what the backend actually sends (Gemini TTS defaults to 24000 Hz);
            a mismatch plays audio back at the wrong pitch/speed since there is no on-device resampler.

    config BROOKESIA_AGENT_CUSTOM_IA_MAX_RECORD_MS
        int "Maximum recording duration in milliseconds"
        default 15000
        help
            Caps how much audio is buffered while the screen is held, to bound RAM usage.

    config BROOKESIA_AGENT_CUSTOM_IA_HTTP_TIMEOUT_MS
        int "HTTP request timeout in milliseconds"
        default 10000

    config BROOKESIA_AGENT_CUSTOM_IA_POLL_INTERVAL_MS
        int "Reply polling interval in milliseconds"
        default 300
        help
            How often to poll the backend's `/out/{callId}` endpoint while waiting for the TTS reply.

    config BROOKESIA_AGENT_CUSTOM_IA_POLL_TIMEOUT_MS
        int "Reply polling timeout in milliseconds"
        default 30000
        help
            Maximum total time to wait for the TTS reply before giving up.

    config BROOKESIA_AGENT_CUSTOM_IA_WORKER_TASK_STACK_SIZE
        int "Worker task stack size in bytes"
        default 12288
        help
            Stack size of the dedicated FreeRTOS task that performs the blocking HTTP upload/poll/playback work.
endmenu
```

## service/media/brookesia_service_bt_speaker/Kconfig
```kconfig
menu "ESP-Brookesia: Service Bluetooth Speaker Configurations"
    config BROOKESIA_SERVICE_BT_SPEAKER_ENABLE_AUTO_REGISTER
        bool "Enable automatic plugin registration"
        default y
        help
            Automatically register the Bluetooth speaker service plugin during startup.

    menuconfig BROOKESIA_SERVICE_BT_SPEAKER_ENABLE_DEBUG_LOG
        bool "Enable debug or lower level logs"
        default n

    if BROOKESIA_SERVICE_BT_SPEAKER_ENABLE_DEBUG_LOG
        config BROOKESIA_SERVICE_BT_SPEAKER_SERVICE_ENABLE_DEBUG_LOG
            bool "Service"
            default y
    endif
endmenu
```

## service/media/brookesia_service_bt_speaker/test_apps/sdkconfig.defaults.esp32p4
```kconfig
CONFIG_IDF_TARGET="esp32p4"
CONFIG_BT_CONTROLLER_DISABLED=y
CONFIG_BT_BLUEDROID_ENABLED=n
CONFIG_BT_NIMBLE_ENABLED=y
CONFIG_BT_NIMBLE_TRANSPORT_UART=n
```

## service/media/brookesia_service_bt_speaker/test_apps/sdkconfig.defaults.esp32s31
```kconfig
CONFIG_IDF_TARGET="esp32s31"
CONFIG_BT_CONTROLLER_ENABLED=y
CONFIG_BT_CLASSIC_ENABLED=y
CONFIG_BT_BLUEDROID_ENABLED=y
CONFIG_BT_NIMBLE_ENABLED=n
CONFIG_BT_A2DP_ENABLE=y
CONFIG_BT_AVRCP_ENABLED=y
```

## service/network/brookesia_service_ble/Kconfig
```kconfig
menu "ESP-Brookesia: Service BLE Configurations"
    config BROOKESIA_SERVICE_BLE_ENABLE_AUTO_REGISTER
        bool "Enable automatic plugin registration"
        default y
        help
            Automatically register the BLE service plugin during startup.

    menuconfig BROOKESIA_SERVICE_BLE_ENABLE_DEBUG_LOG
        bool "Enable debug or lower level logs"
        default n

    if BROOKESIA_SERVICE_BLE_ENABLE_DEBUG_LOG
        config BROOKESIA_SERVICE_BLE_SERVICE_ENABLE_DEBUG_LOG
            bool "Service"
            default y
    endif
endmenu
```

## service/network/brookesia_service_bt/Kconfig
```kconfig
menu "ESP-Brookesia: Service Bluetooth Configurations"
    config BROOKESIA_SERVICE_BT_ENABLE_AUTO_REGISTER
        bool "Enable automatic plugin registration"
        default y
        help
            Automatically register the generic Bluetooth service plugin during startup.

    menuconfig BROOKESIA_SERVICE_BT_ENABLE_DEBUG_LOG
        bool "Enable debug or lower level logs"
        default n

    if BROOKESIA_SERVICE_BT_ENABLE_DEBUG_LOG
        config BROOKESIA_SERVICE_BT_SERVICE_ENABLE_DEBUG_LOG
            bool "Service"
            default y
    endif
endmenu
```

## service/network/brookesia_service_bt/test_apps/sdkconfig.defaults.esp32s3
```kconfig
CONFIG_IDF_TARGET="esp32s3"
CONFIG_BT_BLUEDROID_ENABLED=n
CONFIG_BT_NIMBLE_ENABLED=y
```

## service/system/brookesia_service_usb/Kconfig
```kconfig
menu "ESP-Brookesia: Service USB Configurations"
    depends on SOC_USB_SERIAL_JTAG_SUPPORTED

    config BROOKESIA_SERVICE_USB_ENABLE_AUTO_REGISTER
        bool "Enable automatic plugin registration"
        default y if USJ_ENABLE_USB_SERIAL_JTAG
        default n if !USJ_ENABLE_USB_SERIAL_JTAG
        select USJ_NO_AUTO_LS_ON_CONNECTION if PM_ENABLE && ESP_CONSOLE_USB_SERIAL_JTAG_ENABLED \
            && !SOC_USB_SERIAL_JTAG_SUPPORT_LIGHT_SLEEP
        help
            Automatically register the USB service with ServiceManager.

            The service uses the fixed-function USB Serial/JTAG CDC port.
            Applications must reserve the Serial/JTAG RX stream for the
            service while a host control session is active.

    menuconfig BROOKESIA_SERVICE_USB_ENABLE_DEBUG_LOG
        bool "Enable debug or lower level logs"
        default n

    config BROOKESIA_SERVICE_USB_UPLOAD_ROOT
        string "Host upload root"
        default "/littlefs/usb"
        help
            Absolute storage directory used for host file uploads and USB staging files.

    config BROOKESIA_SERVICE_USB_MAX_TRANSFER_SIZE
        int "Maximum transfer size"
        default 8388608
        range 1 67108864
        help
            Maximum number of bytes accepted for one host upload or BPK package.

    config BROOKESIA_SERVICE_USB_FRAME_PAYLOAD_SIZE
        int "Maximum binary frame payload"
        default 16384
        range 64 65536
        help
            Maximum payload size in one binary transfer frame.

    config BROOKESIA_SERVICE_USB_RX_QUEUE_LENGTH
        int "RX queue length"
        default 8
        range 2 64
        help
            Number of Serial/JTAG RX messages buffered before the protocol
            worker handles them.

    config BROOKESIA_SERVICE_USB_SERIAL_JTAG_RX_BUFFER_SIZE
        int "Serial/JTAG RX buffer size"
        default 4096
        range 128 65536
        help
            RX ring-buffer size used when the service owns the Serial/JTAG
            driver. The console-installed driver keeps its own configuration.

    config BROOKESIA_SERVICE_USB_SERIAL_JTAG_TX_BUFFER_SIZE
        int "Serial/JTAG TX buffer size"
        default 4096
        range 128 65536
        help
            TX ring-buffer size used when the service owns the Serial/JTAG
            driver. The console-installed driver keeps its own configuration.

    config BROOKESIA_SERVICE_USB_COMMAND_TIMEOUT_MS
        int "Service call timeout"
        default 30000
        range 100 600000
        help
            Default timeout for service calls received from the USB host.
endmenu
```
